## meta-SD3-10/meta-ast2600-sdk/conf/machine/include/ast2600-secure.inc
```bitbake
# Secure Boot Settings
require conf/machine/include/ast-secure.inc

ASPEED_SECURE_BOOT_TARGET = "ast2600"

# OpenBMC Settings
FLASH_UBOOT_SPL_IMAGE = "s_u-boot-spl"

# ASPEED Initramfs Settings
ASPEED_IMAGE_UBOOT_SPL_IMAGE = "s_u-boot-spl"

# ASPEED EMMC Settings
ASPEED_EMMC_IMAGE_UBOOT_SPL_IMAGE = "s_u-boot-spl"
ASPEED_EMMC_IMAGE_MERGE_UBOOT_IMAGE = "s_emmc_image-u-boot"
```

## meta-SD3-12/meta-ast2600-sdk/conf/machine/include/ast2600-secure-rsa3072-sha384-cot.inc
```bitbake
SPL_SIGN_ENABLE = "1"
SPL_SIGN_KEYDIR ?= "${STAGING_DATADIR_NATIVE}/aspeed-secure-config/ast2600/security/key"
SPL_SIGN_KEYNAME ?= "test_bl2_3072"

UBOOT_SIGN_ENABLE = "1"
UBOOT_SIGN_KEYDIR ?= "${STAGING_DATADIR_NATIVE}/aspeed-secure-config/ast2600/security/key"
UBOOT_SIGN_KEYNAME ?= "test_bl3_3072"

# Kernel / U-Boot fitImage Hash Algo
FIT_HASH_ALG ?= "sha384"
UBOOT_FIT_HASH_ALG ?= "sha384"

# Kernel / U-Boot fitImage Signature Algo
FIT_SIGN_ALG ?= "rsa3072"
UBOOT_FIT_SIGN_ALG ?= "rsa3072"

# Size of private keys in number of bits
FIT_SIGN_NUMBITS ?= "3072"
UBOOT_FIT_SIGN_NUMBITS ?= "3072"
```

## meta-sophgo/bak/conf/layer.conf
```bitbake
# We have a conf and classes directory, add to BBPATH
BBPATH .= ":${LAYERDIR}"

# We have recipes-* directories, add to BBFILES
BBFILES += "${LAYERDIR}/recipes-*/*/*.bb \
            ${LAYERDIR}/recipes-*/*/*.bbappend"

BBFILE_COLLECTIONS += "meta-sophgo"
BBFILE_PATTERN_meta-sophgo = "^${LAYERDIR}/"
BBFILE_PRIORITY_meta-sophgo = "6"

LAYERDEPENDS_meta-sophgo = "core"
LAYERSERIES_COMPAT_meta-sophgo = "kirkstone langdale"
```

## meta-sophgo/conf/layer.conf
```bitbake
# We have a conf and classes directory, add to BBPATH
BBPATH .= ":${LAYERDIR}"

BBFILES += "${LAYERDIR}/recipes-*/*/*.bb \
            ${LAYERDIR}/recipes-*/*/*.bbappend"

BBFILE_COLLECTIONS += "sophgo-layer"
BBFILE_PATTERN_sophgo-layer := "^${LAYERDIR}/"
LAYERVERSION_sophgo-layer = "1"
# LAYERSERIES_COMPAT_sophgo-layer = "honister kirkstone"
LAYERSERIES_COMPAT_sophgo-layer = "langdale mickledore"
# Provide a variable that points the base of the sophgo layer.
ASPEEDSDKBASE = '${@os.path.normpath("${LAYERDIR}/")}'
```

## meta-sophgo/conf/machine/include/ast-abr.inc
```bitbake
# Enabling AST2600 Alternate Boot Record(ABR) functionality

MACHINE_FEATURES:append = " ast-abr "
MACHINEOVERRIDES .= ":ast-abr"
```

## meta-sophgo/conf/machine/include/ast2600-sdk.inc
```bitbake
SOC_FAMILY = "aspeed-g6"
include conf/machine/include/soc-family.inc
require conf/machine/include/aspeed-sdk.inc
include conf/machine/include/arm/arch-armv7a.inc
```

## meta-sophgo/meta-ast2600-sdk/conf/machine/ast2600-sophgo.conf
```bitbake
require conf/machine/include/ast2600-sdk.inc
require conf/machine/include/ast-ssp.inc
require conf/machine/include/aspeed-tpm2.inc

# Overwrite flash layout
FLASH_SIZE = "65536"
FLASH_UBOOT_SPL_SIZE = "64"
FLASH_UBOOT_OFFSET = "0"
FLASH_KERNEL_OFFSET = "1024"
FLASH_ROFS_OFFSET = "10240"
FLASH_RWFS_OFFSET:flash-65536 = "47104"
RWFS_SIZE = "18874368"

# U-Boot Build Settings
UBOOT_MACHINE = "evb-ast2600-spl_defconfig"
UBOOT_DEVICETREE = "ast2600-sophgo"

SPL_BINARY = "spl/u-boot-spl.bin"
UBOOT_SIGN_ENABLE = "1"
UBOOT_FITIMAGE_ENABLE = "1"

# Kernel Build Settings
# KERNEL_DEVICETREE = "aspeed-ast2600-evb.dtb"
KERNEL_DEVICETREE = "aspeed-ast2600-sophgo.dtb"
KBUILD_DEFCONFIG = "aspeed_g6_defconfig"

MACHINE_FEATURES += "\
        obmc-phosphor-fan-mgmt \
        obmc-phosphor-chassis-mgmt \
        obmc-phosphor-flash-mgmt \
        obmc-host-ipmi \
        obmc-host-state-mgmt \
        obmc-chassis-state-mgmt \
        obmc-bmc-state-mgmt \
        "

PREFERRED_PROVIDER_virtual/obmc-system-mgmt = "packagegroup-aspeed-obmc"
PREFERRED_PROVIDER_virtual/obmc-host-ipmi-hw = "phosphor-ipmi-kcs"
# VIRTUAL-RUNTIME_obmc-host-state-manager ?= "x86-power-control"
# VIRTUAL-RUNTIME_obmc-chassis-state-manager ?= "x86-power-control"
VIRTUAL-RUNTIME_obmc-host-state-manager ?= "sophgo-power-control"
VIRTUAL-RUNTIME_obmc-chassis-state-manager ?= "sophgo-power-control"

EXTRA_IMAGEDEPENDS:append = " \
    aspeed-image-recoveryuart \
    "
```

## meta-sophgo/meta-ast2600-sdk/conf/machine/include/ast2600-secure-rsa2048-sha256-cot.inc
```bitbake
SPL_SIGN_ENABLE = "1"
SPL_SIGN_KEYDIR ?= "${STAGING_DATADIR_NATIVE}/aspeed-secure-config/ast2600/security/key"
SPL_SIGN_KEYNAME ?= "test_bl2_2048"

UBOOT_SIGN_ENABLE = "1"
UBOOT_SIGN_KEYDIR ?= "${STAGING_DATADIR_NATIVE}/aspeed-secure-config/ast2600/security/key"
UBOOT_SIGN_KEYNAME ?= "test_bl3_2048"

# Kernel / U-Boot fitImage Hash Algo
FIT_HASH_ALG ?= "sha256"
UBOOT_FIT_HASH_ALG ?= "sha256"

# Kernel / U-Boot fitImage Signature Algo
FIT_SIGN_ALG ?= "rsa2048"
UBOOT_FIT_SIGN_ALG ?= "rsa2048"

# Size of private keys in number of bits
FIT_SIGN_NUMBITS ?= "2048"
UBOOT_FIT_SIGN_NUMBITS ?= "2048"
```

## meta-sophgo/meta-ast2600-sdk/conf/machine/include/ast2600-secure-rsa4096-sha512-cot.inc
```bitbake
SPL_SIGN_ENABLE = "1"
SPL_SIGN_KEYDIR ?= "${STAGING_DATADIR_NATIVE}/aspeed-secure-config/ast2600/security/key"
SPL_SIGN_KEYNAME ?= "test_bl2_4096"

UBOOT_SIGN_ENABLE = "1"
UBOOT_SIGN_KEYDIR ?= "${STAGING_DATADIR_NATIVE}/aspeed-secure-config/ast2600/security/key"
UBOOT_SIGN_KEYNAME ?= "test_bl3_4096"

# Kernel / U-Boot fitImage Hash Algo
FIT_HASH_ALG ?= "sha512"
UBOOT_FIT_HASH_ALG ?= "sha512"

# Kernel / U-Boot fitImage Signature Algo
FIT_SIGN_ALG ?= "rsa4096"
UBOOT_FIT_SIGN_ALG ?= "rsa4096"

# Size of private keys in number of bits
FIT_SIGN_NUMBITS ?= "4096"
UBOOT_FIT_SIGN_NUMBITS ?= "4096"
```
